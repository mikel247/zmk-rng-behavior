## Kconfig
```kconfig
# Copyright (c) 2024
# SPDX-License-Identifier: MIT

rsource "behaviors/rng_typer/Kconfig"
```

## behaviors/rng_typer/Kconfig
```kconfig
# Copyright (c) 2024
# SPDX-License-Identifier: MIT

config ZMK_BEHAVIOR_RNG_TYPER
    bool "RNG Typer behavior (dice rolls, random ints, random strings)"
    depends on ENTROPY_GENERATOR
    help
      Enables a ZMK behavior that uses the nRF52 hardware RNG to type:
        - Dice rolls in dXX: N format
        - Full raw 32-bit random integers
        - Random 16-character strings with selectable charset

      Key timing follows CONFIG_ZMK_MACRO_DEFAULT_TAP_MS and
      CONFIG_ZMK_MACRO_DEFAULT_WAIT_MS (both default 30ms).

      IMPORTANT: The default behavior queue size (CONFIG_ZMK_BEHAVIORS_QUEUE_SIZE=64)
      is too small for 16-char strings. Add to your .conf:
        CONFIG_ZMK_BEHAVIORS_QUEUE_SIZE=128
```

## dts/bindings/behaviors/zmk,behavior-leader-key.yaml
```yaml
# Copyright (c) 2024 The ZMK Contributors
# SPDX-License-Identifier: MIT

# dts/bindings/zmk,behavior-custom-random.yaml
description: Custom Random Number String Generator

compatible: "zmk,behavior-custom-random"

include: behavior-cells.yaml

properties:
  bindings:
    type: int
    const: 2
```
